## subsys/net/lib/nrf_cloud/Kconfig.nrf_cloud_coap
```kconfig
# Copyright (c) 2023 Nordic Semiconductor
#
# SPDX-License-Identifier: LicenseRef-Nordic-5-Clause
#

menuconfig NRF_CLOUD_COAP
	bool "nRF Cloud COAP"
	select CJSON_LIB
	select ZCBOR
	select COAP
	select COAP_EXTENDED_OPTIONS_LEN
	select COAP_CLIENT
	select EXPERIMENTAL

if NRF_CLOUD_COAP

config NRF_CLOUD_COAP_SERVER_HOSTNAME
	string "CoAP server hostname"
	default "coap.dev.nrfcloud.com"

config NRF_CLOUD_COAP_SEC_TAG
	int "Security tag in which to store credentials"
	default NRF_CLOUD_SEC_TAG

config NRF_CLOUD_COAP_THREAD_STACK_SIZE
	int "Stack size for CoAP reception thread"
	default 4096

config NRF_CLOUD_COAP_SERVER_PORT
	int "CoAP server port"
	default 5684

config NRF_CLOUD_COAP_RESPONSE_TIMEOUT_MS
	int "Number of ms to wait for a response from the CoAP server"
	default 30000

if WIFI

config NRF_CLOUD_COAP_SEND_SSIDS
	bool "Include access point SSIDs with scan results"
	default n
	help
	  The nRF Cloud Wi-Fi location service does not require the human-
	  readable SSIDs in order to determine the device location. It does
	  require the access point MAC addresses. By not including SSIDs
	  the amount of data sent to the cloud is greatly reduced.

endif

module = NRF_CLOUD_COAP
module-str = nRF Cloud COAP
source "subsys/logging/Kconfig.template.log_config"

endif # NRF_CLOUD_COAP
```
